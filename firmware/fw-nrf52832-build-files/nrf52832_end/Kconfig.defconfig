## firmware/fw-nrf52832-build-files/nrf52832_end/Kconfig.defconfig
```kconfig
# nRF52 DK NRF52832 board configuration

# Copyright (c) 2016 Nordic Semiconductor ASA
# SPDX-License-Identifier: Apache-2.0

if BOARD_NRF52832_END

config BOARD
	default "nrf52832_end"

config BT_CTLR
	default BT

endif # BOARD_NRF52832_END
```

## firmware/motherboard-usb-connected-BUILD-FILE/nrf52832_end/Kconfig.board
```kconfig
# nRF52 DK NRF52832 board configuration

# Copyright (c) 2016 Nordic Semiconductor ASA
# SPDX-License-Identifier: Apache-2.0

config BOARD_NRF52832_END
	bool "nrf52832_end"
	depends on SOC_NRF52832_QFAA
```
